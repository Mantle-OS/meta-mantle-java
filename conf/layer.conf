## conf/layer.conf
```bitbake
BBPATH .= ":${LAYERDIR}"
BBFILES += " \
    ${LAYERDIR}/recipes-*/*.bb \
    ${LAYERDIR}/recipes-*/*/*.bb \
    ${LAYERDIR}/recipes-*/*/*/*.bb \
    ${LAYERDIR}/recipes-*/*.bbappend \
    ${LAYERDIR}/recipes-*/*/*.bbappend \
    ${LAYERDIR}/recipes-*/*/*/*.bbappend \
"

LICENSE_PATH += ":${LAYERDIR}/licenses"

BBFILE_COLLECTIONS += "meta-mantle-java"
BBFILE_PATTERN_meta-mantle-java = "^${LAYERDIR}/"
BBFILE_PRIORITY_meta-mantle-java = "6"

## FIXME this will depend on more but for now this will work
LAYERDEPENDS_meta-mantle-java = "core"


LAYERSERIES_COMPAT_meta-mantle-java = "scarthgap"
```
